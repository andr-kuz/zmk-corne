// <>
lt_gt: lt_gt {
  compatible = "zmk,behavior-mod-morph";
  #binding-cells = <0>;
  bindings = <&kp LT>, <&kp GT>;
  mods = <(MOD_LCTL|MOD_RCTL)>;
};

fslh_bslh: fslh_bslh {
  compatible = "zmk,behavior-mod-morph";
  #binding-cells = <0>;
  bindings = <&kp FSLH>, <&kp BSLH>;
  mods = <(MOD_LCTL|MOD_RCTL)>;
};
